/dts-v1/;
/plugin/;

/ {
	compatible = "brcm,bcm2837";

	fragment@0 {
		target = <&i2c1>;
		__overlay__ {
			#address-cells = <1>;
			#size-cells = <0>;

			lcd@3f {
				compatible = "custom,i2c-lcd";
				reg = <0x3f>;
			};
		};
	};
};
